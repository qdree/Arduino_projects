byte s=0, e=0, d=0, a=0; //объявляем переменные единиц, десятков, сотен, тысяч переменную мерцания
byte cif[10]={252, 96, 218, 242, 102, 182, 190, 224, 254, 246}; // массив цифр

void setup()
{
  DDRD=255; // пины порта D и B обозначаем выходными
  DDRB=63;
}

void loop() 
{
  for (s=0; s<10;)
  {// цикл сотен
    for (d=0; d<10;)
    {// цикл десятков
      for (e=0; e<10;)
      {// цикл единиц
        for (a=0; a<18;)
        {// цикл мерцания
          PORTB=59;// активируем разряд сотен
          PORTD=cif[s]; // пишем нужную цифру сотен в порт D
          delay(6);// пауза, чтобы сегменты "разгорелись"
          PORTB=61;// пишем нужную цифру десятков в порт D
          PORTD=cif[d]; // пишем нужную цифру десятка в порт D
          delay(6);// пауза, чтобы сегменты "разгорелись"
          PORTB=62;// пишем нужную цифру единиц в порт D
          PORTD=cif[e]; // пишем нужную цифру единиц в порт D
          delay(6);// пауза, чтобы сегменты "разгорелись"
          a=a+1;// увеличиваем переменную цикла мерцания
        }
        e=e+1;// прибавляем единицу
      }
      d=d+1;// прибавляем десяток
    }
    s=s+1;// прибавляем сотню
  }
  s=0,e=0,d=0,a=0;// обнуляем переменные
}


// void setup() {
// DDRD=B11111111; // пины порта D и B обозначаем выходными
// DDRB=B111111;}
// void loop() {
// PORTB=B001000; // устанавливаем высокий уровень 11 пина порта В
// PORTD=B00000011; // пишем "ноль" в порт D
// delay(500); // пауза полсекунды
// PORTD=B10011111; // пишем "единицу" в порт D
// delay(500);
// PORTD=B00100101; // пишем "двойку" в порт D
// delay(500);
// PORTD=B00001101;// пишем "тройку" в порт D
// delay(500);
// PORTD=B10011001;// пишем "четверку" в порт D
// delay(500);
// PORTD=B01001001;// пишем "пятерку" в порт D
// delay(500);
// PORTD=B01000001;// пишем "шестерку" в порт D
// delay(500);
// PORTD=B00011111;// пишем "семерку" в порт D
// delay(500);
// PORTD=B00000001; // пишем "восьмерку" в порт D
// delay(500);
// PORTD=B00001001; // пишем "девятку" в порт D
// delay(500);}